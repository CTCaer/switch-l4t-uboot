## board/nintendo/icosa/Kconfig
```kconfig
if TARGET_ICOSA

config SYS_BOARD
	default "icosa"

config SYS_VENDOR
	default "nintendo"

config SYS_CONFIG_NAME
	default "icosa"

endif
```

## board/nintendo/switch/Kconfig
```kconfig
if TARGET_NINTENDO_SWITCH

config SYS_BOARD
	default "switch"

config SYS_VENDOR
	default "nintendo"

config SYS_CONFIG_NAME
	default "nintendo-switch"

endif
```

## configs/icosa_defconfig
```kconfig
CONFIG_ARM=y
CONFIG_ARCH_TEGRA=y
CONFIG_SYS_TEXT_BASE=0x80080000
CONFIG_SYS_MALLOC_LEN=0x2500000
CONFIG_NR_DRAM_BANKS=2
CONFIG_ENV_SIZE=0x2000
CONFIG_DEFAULT_DEVICE_TREE="tegra210-icosa"
# CONFIG_TEGRA_CBOOT is not set
CONFIG_TEGRA210=y
CONFIG_TARGET_ICOSA=y
CONFIG_SYS_LOAD_ADDR=0x85000000
CONFIG_ANDROID_BOOT_IMAGE=y
CONFIG_OF_SYSTEM_SETUP=y
CONFIG_CONSOLE_MUX=y
CONFIG_SYS_STDIO_DEREGISTER=y
CONFIG_SYS_PROMPT="Tegra210 (Icosa) # "
# CONFIG_CMD_IMI is not set
CONFIG_CMD_GPIO=y
CONFIG_CMD_I2C=y
CONFIG_CMD_MMC=y
CONFIG_CMD_PCI=y
CONFIG_CMD_READ=y
CONFIG_CMD_USB=y
# CONFIG_CMD_NFS is not set
CONFIG_CMD_EXT4_WRITE=y
CONFIG_CMD_FS_UUID=y
CONFIG_PARTITION_TYPE_GUID=y
CONFIG_OF_LIVE=y
CONFIG_SYS_RELOC_GD_ENV_ADDR=y
# CONFIG_ENV_IS_IN_MMC is not set
CONFIG_SYS_I2C_TEGRA=y
CONFIG_PCI=y
CONFIG_PCI_TEGRA=y
# CONFIG_REQUIRE_SERIAL_CONSOLE is not set
CONFIG_SYS_NS16550=y
CONFIG_USB=y
CONFIG_USB_EHCI_HCD=y
CONFIG_USB_EHCI_TEGRA=y
CONFIG_USB_HOST_ETHER=y
CONFIG_USB_GADGET=y
CONFIG_USB_GADGET_MANUFACTURER="NVIDIA"
CONFIG_USB_GADGET_VENDOR_NUM=0x0955
CONFIG_USB_GADGET_PRODUCT_NUM=0x701a
CONFIG_CI_UDC=y
CONFIG_OF_LIBFDT_OVERLAY=y
```

## configs/nintendo-switch_defconfig
```kconfig
CONFIG_ARM=y
CONFIG_TEGRA=y
CONFIG_TEGRA210=y
CONFIG_TEGRA210_CARVEOUT_EXACT_SIZE=y
CONFIG_TARGET_NINTENDO_SWITCH=y
CONFIG_ARMV8_SEC_FIRMWARE_SUPPORT=y
CONFIG_SEC_FIRMWARE_ARMV8_PSCI=y
# CONFIG_PSCI_RESET is not set
CONFIG_DEFAULT_DEVICE_TREE="tegra210-nintendo-switch"
CONFIG_ANDROID_BOOT_IMAGE=y
CONFIG_POSITION_INDEPENDENT=y
CONFIG_SYS_MALLOC_F_LEN=0x2000
CONFIG_SYS_STDIO_DEREGISTER=y
CONFIG_SYS_PROMPT="Switch # "
CONFIG_OF_SYSTEM_SETUP=y
CONFIG_ENV_IS_NOWHERE=y
CONFIG_BOOTDELAY=0
CONFIG_BOOTCOMMAND="run distro_bootcmd"
CONFIG_CONSOLE_MUX=y
# CONFIG_CMD_BOOTD is not set
# CONFIG_CMD_BOOTI is not set
# CONFIG_CMD_BOOTZ is not set
CONFIG_CMD_BOOTM=y
CONFIG_CMD_GPIO=y
CONFIG_CMD_I2C=y
CONFIG_CMD_MMC=y
CONFIG_CMD_READ=y
CONFIG_CMD_SETEXPR=y
CONFIG_CMD_DTIMG=y
# CONFIG_CMD_NET is not set
# CONFIG_CMD_IMI is not set
# CONFIG_CMD_FLASH is not set
# CONFIG_CMD_FPGA is not set
# CONFIG_CMD_NFS is not set
# CONFIG_CMD_LZMADEC is not set
# CONFIG_FAT_WRITE is not set
CONFIG_FAT_FAST=y
CONFIG_FAT_EXFAT=y
# CONFIG_ISO_PARTITION is not set
# CONFIG_EFI_LOADER is not set
CONFIG_PARTITION_TYPE_GUID=y
CONFIG_OF_LIVE=y
CONFIG_OF_LIBFDT_OVERLAY=y
CONFIG_LZ4=y
CONFIG_LZO=y
CONFIG_SPL_GZIP=y
# CONFIG_REQUIRE_SERIAL_CONSOLE is not set
CONFIG_SYS_NS16550=y
CONFIG_DM_VIDEO=y
CONFIG_BACKLIGHT_PWM=n
CONFIG_CONSOLE_ROTATION=y
CONFIG_VIDEO_SIMPLE=y
CONFIG_NO_FB_CLEAR=y
# CONFIG_VIDEO_BPP8 is not set
# CONFIG_VIDEO_BPP16 is not set
CONFIG_CC_OPTIMIZE_LIBS_FOR_SPEED=y
CONFIG_REGEX=y
```
